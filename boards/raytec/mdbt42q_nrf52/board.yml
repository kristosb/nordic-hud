## boards/raytec/mdbt42q_nrf52/board.yml
```yaml
# Copyright (c) 2024 Nordic Semiconductor ASA
# SPDX-License-Identifier: Apache-2.0

board:
  name: mdbt42q_nrf52
  vendor: raytec
  socs:
    - name: nrf52832
```

## boards/raytec/mdbt42q_nrf52/mdbt42q_nrf52_defconfig
```kconfig
# Copyright (c) 2021 Nordic Semiconductor ASA
# SPDX-License-Identifier: Apache-2.0
#CONFIG_SOC_SERIES_NRF52X=y
#CONFIG_SOC_NRF52832_QFAA=y
#CONFIG_BOARD_MDBT42Q_NRF52=y

CONFIG_ARM_MPU=y
CONFIG_HW_STACK_PROTECTION=y

CONFIG_BOARD_ENABLE_DCDC=n
# MDBT42Q doesnt have oscillator connected. Enable internal RC by default
CONFIG_CLOCK_CONTROL_NRF_K32SRC_RC=y

# Enable UART console on all configurations for convenience. This is usually
# done at board level upstream so that all samples output printed messages to
# the configured #zephyr,console. In production boards, this may be enabled at
# application level or in a debug configuration overlay.
CONFIG_SERIAL=y
CONFIG_CONSOLE=y
CONFIG_UART_CONSOLE=y

# enable GPIO
CONFIG_GPIO=y
CONFIG_PINCTRL=y
```

## drivers/display/st7735s/Kconfig
```kconfig
# Display drivers

# Copyright (c) 2017 Intel Corporation
# SPDX-License-Identifier: Apache-2.0

# source "drivers/display/Kconfig.st7735s"

config ST7735S
	bool "ST7735S display driver"
	default y
	depends on DT_HAS_SITRONIX_ST7735S_ENABLED
	select SPI
	help
	  Enable driver for ST7735S display driver.
```

## drivers/sensor/bmi05x/Kconfig
```kconfig
# Bosch BMI05X inertial measurement configuration options

# Copyright (c) 2022 Meta Platforms, Inc. and its affiliates
# SPDX-License-Identifier: Apache-2.0

menuconfig BMI05X
	bool "Bosch BMI05X inertial measurement unit"
	default y
	depends on DT_HAS_BOSCH_BMI05X_ACCEL_ENABLED || DT_HAS_BOSCH_BMI05X_GYRO_ENABLED
	select I2C if $(dt_compat_on_bus,$(DT_COMPAT_BOSCH_BMI05X_ACCEL),i2c) \
		|| $(dt_compat_on_bus,$(DT_COMPAT_BOSCH_BMI05X_GYRO),i2c)
	select SPI if $(dt_compat_on_bus,$(DT_COMPAT_BOSCH_BMI05X_ACCEL),spi) \
		|| $(dt_compat_on_bus,$(DT_COMPAT_BOSCH_BMI05X_GYRO),spi)
	help
	  Enable Bosch BMI05X inertial measurement unit that provides acceleration
	  and angular rate measurements.

if BMI05X

choice BMI05X_ACCEL_TRIGGER_MODE
	prompt "Accelerometer trigger mode"
	default BMI05X_ACCEL_TRIGGER_GLOBAL_THREAD
	help
	  Specify the type of triggering to be used by the driver.

config BMI05X_ACCEL_TRIGGER_NONE
	bool "No trigger"

config BMI05X_ACCEL_TRIGGER_GLOBAL_THREAD
	bool "Use global thread"
	select BMI05X_ACCEL_TRIGGER

config BMI05X_ACCEL_TRIGGER_OWN_THREAD
	bool "Use own thread"
	select BMI05X_ACCEL_TRIGGER
endchoice

config BMI05X_ACCEL_TRIGGER
	bool

config BMI05X_ACCEL_THREAD_PRIORITY
	int "Accelerometer own thread priority"
	depends on BMI05X_ACCEL_TRIGGER_OWN_THREAD
	default 10
	help
	  The priority of the thread used for handling interrupts.

config BMI05X_ACCEL_THREAD_STACK_SIZE
	int "Accelerometer own thread stack size"
	depends on BMI05X_ACCEL_TRIGGER_OWN_THREAD
	default 1536
	help
	  The thread stack size.

choice BMI05X_GYRO_TRIGGER_MODE
	prompt "Gyroscope trigger mode"
	default BMI05X_GYRO_TRIGGER_NONE
	default BMI05X_GYRO_TRIGGER_GLOBAL_THREAD
	help
	  Specify the type of triggering to be used by the driver.

config BMI05X_GYRO_TRIGGER_NONE
	bool "No trigger"

config BMI05X_GYRO_TRIGGER_GLOBAL_THREAD
	bool "Use global thread"
	select BMI05X_GYRO_TRIGGER

config BMI05X_GYRO_TRIGGER_OWN_THREAD
	bool "Use own thread"
	select BMI05X_GYRO_TRIGGER
endchoice

config BMI05X_GYRO_TRIGGER
	bool

config BMI05X_GYRO_THREAD_PRIORITY
	int "Own thread priority"
	depends on BMI05X_GYRO_TRIGGER_OWN_THREAD
	default 10
	help
	  The priority of the thread used for handling interrupts.

config BMI05X_GYRO_THREAD_STACK_SIZE
	int "Own thread stack size"
	depends on BMI05X_GYRO_TRIGGER_OWN_THREAD
	default 1536
	help
	  The thread stack size.

config BMI05X_I2C_WRITE_BURST_SIZE
	int "Maximum length of single i2c write"
	default 16

endif # BMI05X
```

## drivers/sensor/bno055/Kconfig
```kconfig
# BNO055 6 Axis IMU configuration

# Copyright (c) 2021 Bosch Sensortec GmbH
# Copyright (c) 2022 Nordic Semiconductor ASA
# SPDX-License-Identifier: Apache-2.0

menuconfig BNO055
	bool "BNO055 Inertial measurement unit"
	default y
	depends on DT_HAS_BOSCH_BNO055_ENABLED
	select I2C if $(dt_compat_on_bus,$(DT_COMPAT_BOSCH_BNO055),i2c)
	select SPI if $(dt_compat_on_bus,$(DT_COMPAT_BOSCH_BNO055),spi)
	help
	  Enable driver for BNO055 I2C-based imu sensor

if BNO055

config BNO055_BUS_I2C
	bool
	default y
	depends on $(dt_compat_on_bus,$(DT_COMPAT_BOSCH_BNO055),i2c)

config BNO055_BUS_SPI
	bool
	default y
	depends on $(dt_compat_on_bus,$(DT_COMPAT_BOSCH_BNO055),spi)

choice BNO055_TRIGGER_MODE
	prompt "Trigger mode"
	help
	  Specify the type of triggering to be used by the driver.

config BNO055_TRIGGER_NONE
	bool "No trigger"

config BNO055_TRIGGER_GLOBAL_THREAD
	bool "Use global thread"
	depends on GPIO
	select BNO055_TRIGGER

config BNO055_TRIGGER_OWN_THREAD
	bool "Use own thread"
	depends on GPIO
	select BNO055_TRIGGER

endchoice

config BNO055_TRIGGER
	bool

config BNO055_THREAD_PRIORITY
	int "Thread priority"
	depends on BNO055_TRIGGER_OWN_THREAD
	default 10
	help
	  Priority of thread used by the driver to handle interrupts.

config BNO055_THREAD_STACK_SIZE
	int "Thread stack size"
	depends on BNO055_TRIGGER_OWN_THREAD
	default 1024
	help
	  Stack size of thread used by the driver to handle interrupts.

endif # BNO055
```

## dts/bindings/sensor/bosch,bno055-spi.yaml
```yaml
# Copyright (c) 2022, Nordic Semiconductor ASA
# SPDX-License-Identifier: Apache-2.0

compatible: "bosch,bno055"

include: ["spi-device.yaml", "bosch,bno055.yaml"]
```

## dts/bindings/sensor/bosch,bno055.yaml
```yaml
# Copyright (c) 2021, Bosch Sensortec GmbH
# Copyright (c) 2022, Nordic Semiconductor ASA
# SPDX-License-Identifier: Apache-2.0

description: |
    The BNO055 is an inertial measurement unit. See more info at:
    https://www.bosch-sensortec.com/products/motion-sensors/imus/bno055.html

include: sensor-device.yaml

compatible: "bosch,bno055"

properties:
  irq-gpios:
    type: phandle-array
    description: |
      The INT1 and (optional) INT2 signal connections.
```

## lib/Kconfig
```kconfig
# Copyright (c) 2024 kristosb
# MIT License

menu "Custom libraries"

rsource "custom/Kconfig"
rsource "lv_compass/Kconfig"
rsource "lv_pitch_ladder/Kconfig"

endmenu
```

## lib/lv_hud/Kconfig
```kconfig
# Copyright (c) 2021, Legrand North America, LLC.
# SPDX-License-Identifier: Apache-2.0

config LV_HUD
	bool "Support for lv_hud library"
	help
	  This option enables the 'lv_hud' library

config LV_HUD_GET_VALUE_DEFAULT
	int "custom_get_value() default return value"
	depends on LV_HUD
	default 0
	help
	  This option primarily exists as an example of a library Kconfig
	  setting.

	  This option specifies the value for custom_get_value() to return
	  when the input parameter is zero. (Otherwise the function returns the
	  input parameter value.)
```

## lib/lv_pitch_ladder/Kconfig
```kconfig
# Copyright (c) 2021, Legrand North America, LLC.
# SPDX-License-Identifier: Apache-2.0

config LV_PITCH_LADDER
	bool "Support for lv_pitch_ladder library"
	help
	  This option enables the 'lv_ptich_ladder' library

# config LV_PITCH_LADDER_GET_VALUE_DEFAULT
# 	int "custom_get_value() default return value"
# 	depends on LV_PITCH_LADDER
# 	default 0
# 	help
# 	  This option primarily exists as an example of a library Kconfig
# 	  setting.

# 	  This option specifies the value for custom_get_value() to return
# 	  when the input parameter is zero. (Otherwise the function returns the
# 	  input parameter value.)
```
